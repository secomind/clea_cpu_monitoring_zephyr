## west.yml
```yaml
manifest:
  self:
    west-commands: scripts/west-commands.yml

  remotes:
    - name: zephyrproject-rtos
      url-base: https://github.com/zephyrproject-rtos
    - name: edgehog-device-manager
      url-base: https://github.com/edgehog-device-manager

  projects:
    - name: zephyr
      remote: zephyrproject-rtos
      revision: v4.1.0
      import: true
    - name: edgehog-device-manager
      remote: edgehog-device-manager
      repo-path: edgehog-zephyr-device.git
      revision: v0.8.0
      import: true
```
